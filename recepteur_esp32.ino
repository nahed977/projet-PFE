#define BLYNK_TEMPLATE_ID "TMPL2L9pmwxkW"
#define BLYNK_TEMPLATE_NAME "ESP32 IoT"
#define BLYNK_AUTH_TOKEN "Y3mQC1XoBzgPJnNvdnjjqVb0JxJghrC2"
#define BLYNK_PRINT Serial

#include <Wire.h>
#include <WiFi.h>
#include <esp_now.h>
#include <BlynkSimpleEsp32.h>
#include <PubSubClient.h>
#include <ArduinoJson.h>
#include <IRremoteESP8266.h>
#include <IRsend.h>
#include <esp_task_wdt.h>
#include "Adafruit_SHT31.h"


// CONFIGURATION UTILISATEUR


char ssid[] = "Ooredoo 4G_91E7A8";
char pass[] = "5YF6276622";
const char* MQTT_BROKER = "192.168.1.33";
const int MQTT_PORT = 1883;
const char* TOPIC_DATA = "esp32/sensors";
const char* TOPIC_CONTROL = "esp32/ac/control";

// CONFIGURATION MATERIELLE


const uint8_t I2C_SDA = 21;
const uint8_t I2C_SCL = 22;
const uint8_t IR_SEND_PIN = 4;
//const uint8_t IR_SEND_PIN_BACKUP = 26;
const int WDT_TIMEOUT = 60;


// INTERVALLES DE TEMPS


const unsigned long SENSOR_READ_INTERVAL = 300000UL;     // 5min - SensorTask
const unsigned long CONTROL_CHECK_INTERVAL = 300000UL;   // 5min - ControlTask
const unsigned long SUPERVISION_INTERVAL = 30000UL;     // 30s - SupervisionTask
const unsigned long WATCHDOG_CHECK_INTERVAL = 30000UL;  // 30s - WatchdogTask
const unsigned long BLYNK_UPDATE_INTERVAL = 30000UL;
const unsigned long MQTT_PUBLISH_INTERVAL = 30000UL;
const unsigned long IR_COOLDOWN = 300UL;
const unsigned long NOTIFICATION_INTERVAL = 1 * 60 * 1000; // 1 minute  
const unsigned long DATA_VALID_TIMEOUT = 300000UL;


// SEUILS DE CONTROLE


const float TEMP_MIN = 20.0;
const float TEMP_MAX = 26.0;
const float HUMIDITY_MIN = 25.0;
const float HUMIDITY_MAX = 75.0;

// OBJETS GLOBAUX


Adafruit_SHT31 sht31 = Adafruit_SHT31();
WiFiClient espClient;
PubSubClient mqttClient(espClient);
IRsend irsend(IR_SEND_PIN);
//IRsend irsend_backup(IR_SEND_PIN_BACKUP);
WidgetLCD lcd(V8);


//  Trames IR - A REMPLIR PAR L'UTILISATEUR


//  POWER
uint16_t powerON[211] = {8970, 4536, 514, 1732, 514, 1732, 514, 594, 514, 594, 516, 594, 514,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 594, 514};

uint16_t powerOFF[211] = {8980, 4522, 530, 1718, 528, 1718, 530, 580, 528, 580, 528, 580, 528,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 576, 532};


//  MODES
uint16_t modeAuto[211] = {8958, 4542,  508, 1738,  508, 1742,  506, 602,  506, 604,  506, 602,  508,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 602,  506};

uint16_t modeCool[211] = {8962, 4542,  508, 1736,  510, 1736,  530, 580,  508, 600,  510, 600,  510,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 600,  508};

uint16_t modeDry[211] = {8984, 4518,  552, 1694,  552, 1694,  552, 556,  552, 558,  552, 556,  552,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 558,  552};  

uint16_t modeHeat[211] = {8964, 4538,  510, 1736,  510, 1738,  508, 600,  510, 598,  512, 600,  510,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 1738,  526};

uint16_t modeFan[211] = {8968, 4534, 516, 1730, 516, 1730, 516, 594, 514, 594, 516, 594, 516,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 1732, 514};


//  Vitesse ventilateur 
uint16_t speedHigh[211] = {8968, 4536,  516, 1730,  516, 1732,  514, 594,  514, 594,  514, 594,  516,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 1730,  516};

uint16_t speedMedium[211] = {8968, 4534, 516, 1730, 516, 1730, 516, 594, 514, 594, 516, 594, 516,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 1732, 514};

uint16_t speedLow[211] = {8966, 4534, 516, 1732, 514, 1732, 514, 596, 514, 594, 514, 594, 514,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 1714, 532};




// Temérature 16-30°C 
uint16_t temp16[211] = {8966, 4536,  514, 1732,  514, 1734,  514, 594,  514, 596,  514, 594,  514,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 1732,  516};

uint16_t temp17[211] = {8968, 4536,  514, 1734,  514, 1732,  514, 596,  514, 596,  514, 596,  512,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 1732,  514};

uint16_t temp18[211] = {8966, 4536,  514, 1732,  514, 1732,  534, 576,  534, 576,  532, 576,  534,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 1734,  512};

uint16_t temp19[211] = {8966, 4536,  514, 1734,  532, 1714,  512, 596,  514, 596,  514, 596,  532,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 1732,  534};

uint16_t temp20[211] = {8980, 4526,  528, 1718,  528, 1718,  528, 582,  528, 580,  528, 582,  528,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 1718,  528};

uint16_t temp21[211] = {8962, 4540,  510, 1738,  510, 1738,  510, 600,  510, 600,  510, 600,  510,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 1732,  516};

uint16_t temp22[211] = {8966, 4536,  512, 1734,  514, 1732,  514, 596,  514, 596,  514, 596,  514,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 1734,  512};

uint16_t temp23[211] = {8966, 4538,  532, 1714,  534, 1714,  532, 576,  532, 578,  532, 578,  532,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 596,  514}; 

uint16_t temp24[211] = {8962, 4542,  508, 1736,  510, 1736,  530, 580,  508, 600,  510, 600,  510,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 600,  508};

uint16_t temp25[211] = {8988, 4518,  514, 1734,  532, 1714,  514, 596,  514, 596,  532, 578,  532,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 594,  514};

uint16_t temp26[211] = {8962, 4542,  506, 1740,  506, 1738,  508, 602,  508, 600,  508, 602,  508,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 584,  506};

uint16_t temp27[211] = {8966, 4534,  514, 1732,  516, 1732,  514, 594,  514, 594,  516, 594,  516,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 594,  514};  

uint16_t temp28[211] = {8970, 4534,  516, 1730,  516, 1732,  514, 594,  516, 594,  514, 594,  516,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 596,  514};  

uint16_t temp29[211] = {8984, 4518,  552, 1694,  552, 1696,  552, 556,  552, 556,  554, 556,  552,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 554,  554};

uint16_t temp30[211] = {8988, 4516,  534, 1714,  534, 1714,  532, 576,  534, 576,  534, 574,  516,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 574,  534};  



// Lumiére
uint16_t light[211] = {8966, 4536,  532, 1714,  532, 1714,  534, 576,  534, 576,  532, 576,  532,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 576,  532};



//  STRUCTURES DE DONNEES


//  Structure compatible avec l'émetteur 
typedef struct struct_message {
  float temperature;
  float humidite;
  unsigned long timestamp;
} struct_message;

//  Structure pour commandes IR 
typedef struct { 
  uint8_t type;   // 0=power , 1=mode, 2=temp, 3=speed, 4=light
  int value;
} IRCommand;

//  Structure pour BroadcastQueue
typedef struct {
  float temperature;
  float humidity;
  unsigned long timestamp;
  bool isValid;
} AveragedData;

// État du système
struct SystemState {
  // Données capteurs
  float localTemp = 0;
  float localHumidity = 0;
  float remoteTemp = 0;
  float remoteHumidity = 0;
  float avgTemp = 0;
  float avgHumidity = 0;
  bool remoteDataValid = false;
  unsigned long remoteDataTimestamp = 0;

  // État climatiseur
  bool acPowerState = false;
  int currentMode = 1;  // 0=Auto, 1=Cool, 2=Dry, 3=Heat, 4=Fan
  int currentTemp = 23;
  int currentSpeed = 0; // 0=Auto, 1=Low, 2=Med, 3=High
  bool autoModeActive = false;




  // Alertes
  bool alertTempHighSent = false;
  bool alertTempLowSent = false;
  bool alertHumidityHighSent = false;
  bool alertHumidityLowSent = false;

  // Timestamps
  unsigned long lastIRCommand = 0;
  unsigned long lastBlynkUpdate = 0;
  unsigned long lastMqttPublish = 0;
  unsigned long lastNotification = 0;

  // Compteurs watchdog
  volatile uint32_t sensorTaskCounter = 0;
  volatile uint32_t controlTaskCounter = 0;
  volatile uint32_t supervisionTaskCounter = 0;
  uint32_t lastSensorCount = 0;
  uint32_t lastControlCount = 0;
  uint32_t lastSupervisionCount = 0;
  uint32_t watchdogResets = 0;
} systemState;


//   OBJETS FREERTOS


QueueHandle_t BroadcastQueue;
QueueHandle_t irCommandQueue;
SemaphoreHandle_t dataMutex;
SemaphoreHandle_t i2cMutex;

TaskHandle_t sensorTaskHandle = NULL;
TaskHandle_t controlTaskHandle = NULL;
TaskHandle_t supervisionTaskHandle = NULL;
TaskHandle_t watchdogTaskHandle = NULL;
TaskHandle_t irTaskHandle = NULL;


//    FONCTION ENVOI TEMPÉRATURE IR


void sendTempIR(int temp) {
  switch(temp) {
    case 16: irsend.sendRaw(temp16, 211, 38); break;
    case 17: irsend.sendRaw(temp17, 211, 38); break;
    case 18: irsend.sendRaw(temp18, 211, 38); break;
    case 19: irsend.sendRaw(temp19, 211, 38); break;
    case 20: irsend.sendRaw(temp20, 211, 38); break;
    case 21: irsend.sendRaw(temp21, 211, 38); break;
    case 22: irsend.sendRaw(temp22, 211, 38); break;
    case 23: irsend.sendRaw(temp23, 211, 38); break;
    case 24: irsend.sendRaw(temp24, 211, 38); break;
    case 25: irsend.sendRaw(temp25, 211, 38); break;
    case 26: irsend.sendRaw(temp26, 211, 38); break;
    case 27: irsend.sendRaw(temp27, 211, 38); break;
    case 28: irsend.sendRaw(temp28, 211, 38); break;
    case 29: irsend.sendRaw(temp29, 211, 38); break;
    case 30: irsend.sendRaw(temp30, 211, 38); break;
    default: Serial.println("[IR] Température invalide"); break;
  }
}


//    FONCTION ENVOI COMMANDE IR (via Queue)


void sendIRCommand(uint8_t type, int value) {
  IRCommand cmd = {type, value};
  if (xQueueSend(irCommandQueue, &cmd, pdMS_TO_TICKS(100)) != pdTRUE) {
    Serial.println("[IR] Queue pleine!");
  }
}






//   CALLBACK ESP-NOW (Réception données émetteur)


void onDataRecv(const esp_now_recv_info *info, const uint8_t *data, int len) {
  if (len == sizeof(struct_message)) {
    struct_message receivedData;
    memcpy(&receivedData, data, sizeof(receivedData));

    if (xSemaphoreTake(dataMutex, pdMS_TO_TICKS(100)) == pdTRUE) {
      systemState.remoteTemp = receivedData.temperature;
      systemState.remoteHumidity = receivedData.humidite;
      systemState.remoteDataTimestamp = millis();
      systemState.remoteDataValid = true;
      xSemaphoreGive(dataMutex);

      Serial.printf("[ESP-NOW] Recu: T=%.1f°C H=%.1f%% ts=%lu\n",
                    receivedData.temperature, receivedData.humidite, receivedData.timestamp);
    }
  }
}


//  AFFICHAGE LCD


void updateLCDDisplay() {
  lcd.clear();

  // Ligne 0: État AC et température
  if (systemState.acPowerState) {
    lcd.print(0, 0, "ON");
    const char* modes[] = {"Auto", "Cool", "Dry", "Heat", "Fan"};
    if (systemState.currentMode >= 0 && systemState.currentMode <= 4) {
      lcd.print(4, 0, modes[systemState.currentMode]);
    }
  } else {
    lcd.print(0, 0, "OFF");
  }
  lcd.print(9, 0, String(systemState.avgTemp, 1) + "c");

  // Ligne 1: Température consigne et humidité
  lcd.print(0, 1, "Set:" + String(systemState.currentTemp) + "C");
  lcd.print(9, 1, String((int)systemState.avgHumidity) + "%");

  // indicateur mode auto
  if (systemState.autoModeActive) {
    lcd.print(14, 1, "A");
  }
}


//    MISE A JOUR WIDGETS BLYNK


void updateBlynkWidgets() {
  Blynk.virtualWrite(V6, systemState.avgTemp);
  Blynk.virtualWrite(V7, systemState.avgHumidity);
  Blynk.virtualWrite(V9, systemState.avgTemp);
  Blynk.virtualWrite(V10, systemState.avgHumidity);
  Blynk.virtualWrite(V0, systemState.acPowerState);

  // ← AJOUTER ICI : backup
  //Blynk.virtualWrite(V12, systemState.backupActif ? 255 : 0);
  //Blynk.virtualWrite(V13, systemState.backupPowerState);
}


//   NOTIFICATIONS ET ALERTES


void checkAndNotify() {
  unsigned long now = millis();
  if (now - systemState.lastNotification < NOTIFICATION_INTERVAL) return;

  
  // Température haute > 25°C
 if (systemState.avgTemp > TEMP_MAX) {
    if (!systemState.alertTempHighSent) {
      Blynk.logEvent("temp_high", String("🔺 Température élevée: ") + String(systemState.avgTemp, 1) + "°c");
      systemState.alertTempHighSent = true;
      systemState.lastNotification = now;
      Serial.println("[ALERTE] Température haute!");
    }
  } else {
    systemState.alertTempHighSent = false;
  }

  // Température basse < 20°C
  if (systemState.avgTemp < TEMP_MIN) {
    if (!systemState.alertTempLowSent) {
      Blynk.logEvent("temp_low", String("❄️ Température basse: ") + String(systemState.avgTemp, 1) + "°c");
      systemState.alertTempLowSent = true;
      systemState.lastNotification = now;
      Serial.println("[ALERTE] Température basse!");
    }
  } else {
    systemState.alertTempLowSent = false;
  }

  // Humidité haute > 75%
  if (systemState.avgHumidity > HUMIDITY_MAX) {
    if (!systemState.alertHumidityHighSent) {
      Blynk.logEvent("humidity_high", String("🌊 Humidité élevée: ") + String(systemState.avgHumidity, 1));
      systemState.alertHumidityHighSent = true;
      systemState.lastNotification = now;
      Serial.println("[ALERTE] Humidité haute!");
    }
  } else {
    systemState.alertHumidityHighSent = false;
  }

  // Humidité basse < 25%
  if (systemState.avgHumidity < HUMIDITY_MIN) {
    if (!systemState.alertHumidityLowSent) {
      Blynk.logEvent("humidity_low", String("🟥 Humidité basse: ") + String(systemState.avgHumidity, 1));
      systemState.alertHumidityLowSent = true;
      systemState.lastNotification = now;
      Serial.println("[ALERTE] Humidité basse!");
    }
  } else {
    systemState.alertHumidityLowSent = false;
  }
}


void controleHumidite(float h) {

  // 1. Si humidité > 75% -> Mode DRY
  if (h > HUMIDITY_MAX && systemState.currentMode != 2) {
    Serial.println("[CTRL] Humidité > 75% -> Activation MODE DRY");
    if (!systemState.acPowerState) {
      sendIRCommand(0, 1);
      systemState.acPowerState = true;
      vTaskDelay(pdMS_TO_TICKS(500));
    }
    sendIRCommand(1, 2);
    systemState.currentMode = 2;
  }

  // 2. Si humidité < 25% -> Contrôler selon température
  else if (h < HUMIDITY_MIN) {
    Serial.println("[CTRL] Humidité < 25% -> Vérification température");
    if (systemState.avgTemp > TEMP_MAX) {
      sendIRCommand(1, 1); // COOL
      systemState.currentMode = 1;
    } else if (systemState.avgTemp < TEMP_MIN) {
      sendIRCommand(1, 3); // HEAT
      systemState.currentMode = 3;
    } else {
      sendIRCommand(1, 4); // FAN
      systemState.currentMode = 4;
    }
  }

  // 3. Si humidité entre 25-75% -> Mode FAN
  else if (systemState.currentMode != 4) {
    Serial.println("[CTRL] Humidité OK -> Mode FAN");
    sendIRCommand(1, 4);
    systemState.currentMode = 4;
  }
}


// CONTRÔLE TEMPÉRATURE


void controleTemperature(float t) {
  // Priorité au contrôle humidité si mode DRY actif
  if (systemState.currentMode == 2) {
    return;
  }

  // Si température > 26°C -> Mode COOL
  if (t > TEMP_MAX && (!systemState.acPowerState || systemState.currentMode != 1)) {
    Serial.println("[CTRL] Température > 26°C -> Activation MODE COOL");

    if (!systemState.acPowerState) {
      sendIRCommand(0, 1); // Power ON
      systemState.acPowerState = true;
      vTaskDelay(pdMS_TO_TICKS(500));
    }

    sendIRCommand(1, 1); // Mode COOL
    systemState.currentMode = 1;
  } 
// Si température < 20°C -> Mode HEAT
  else if (t < TEMP_MIN && (!systemState.acPowerState || systemState.currentMode != 3)) {
    Serial.println("[CTRL] Température < 20°C -> Activation MODE HEAT");

    if (!systemState.acPowerState) {
      sendIRCommand(0, 1); // Power ON
      systemState.acPowerState = true;
      vTaskDelay(pdMS_TO_TICKS(500));
    }
    sendIRCommand(1, 3); // ← AJOUTE ICI
    systemState.currentMode = 3; // ← AJOUTE ICI
  }

    // NOUVEAU : température dans la plage → passer en FAN au lieu d'éteindre
  else if (t >= TEMP_MIN && t <= TEMP_MAX && 
           systemState.acPowerState && 
           systemState.currentMode != 4) {
    Serial.println("[CTRL] Température OK → passage MODE FAN");
    sendIRCommand(1, 4);              // Mode FAN
    systemState.currentMode = 4;
  }
}











//    PUBLICATION MQTT


void publishSensorData() {
  StaticJsonDocument<512> doc;

  doc["device_id"] = "ESP32_AC_001";
  doc["device"] = "esp32-ac-sht31";
  doc["temperature"] = systemState.avgTemp;
  doc["humidity"] = systemState.avgHumidity;
  doc["local_temp"] = systemState.localTemp;
  doc["local_humidity"] = systemState.localHumidity;
  doc["remote_temp"] = systemState.remoteTemp;
  doc["remote_humidity"] = systemState.remoteHumidity;
  doc["ts_ms"] = millis();

  doc["ac_power"] = systemState.acPowerState;
  doc["ac_mode"] = systemState.currentMode;
  doc["ac_temp_set"] = systemState.currentTemp;
  doc["ac_fan_speed"] = systemState.currentSpeed;
  doc["auto_mode"] = systemState.autoModeActive;
  doc["status"] = "ok";

  char payload[512];
  serializeJson(doc, payload);

  if (mqttClient.publish(TOPIC_DATA, payload, false)) {
    Serial.println("[MQTT] Données publiées");
  } else {
    Serial.println("[MQTT] Echec publication");
  }
}
  

//  CALLBACK MQTT


void mqttCallback(char* topic, byte* payload, unsigned int length) {
  char msg[length + 1];
  memcpy(msg, payload, length);
  msg[length] = '\0';

  Serial.printf("[MQTT] Message reçu: %s\n", msg);

  StaticJsonDocument<256> doc;
  if (deserializeJson(doc, msg) == DeserializationError::Ok) {
    bool updated = false;

    if (doc.containsKey("power")) {
      int p = doc["power"];
      sendIRCommand(0, p);
      systemState.acPowerState = p;
      updated = true;
    }

    if (doc.containsKey("temperature")) {
      int t = doc["temperature"];
      if (t >= 16 && t <= 30) {
        systemState.currentTemp = t;
        sendIRCommand(2, t);
        updated = true;
      }
    }

    if (doc.containsKey("mode")) {
      int m = doc["mode"];
      if (m >= 0 && m <= 4) {
        systemState.currentMode = m;
        sendIRCommand(1, m);
        updated = true;
      }
    }

    if (doc.containsKey("fan_speed")) {
      int s = doc["fan_speed"];
      if (s >= 0 && s <= 3) {
        systemState.currentSpeed = s;
        sendIRCommand(3, s);
        updated = true;
      }
    }

    if (doc.containsKey("auto_mode")) {
      systemState.autoModeActive = doc["auto_mode"];
      updated = true;
    }

    if (updated) {
      updateLCDDisplay();
      updateBlynkWidgets();
    }
  }
}


//  CONNEXION MQTT


void connectMQTT() {
  if (mqttClient.connected()) return;

  Serial.println("[MQTT] Connexion...");

  String clientId = "ESP32-RX-" + String((uint32_t)ESP.getEfuseMac(), HEX);

  if (mqttClient.connect(clientId.c_str())) {
    Serial.println("[MQTT] Connecté");
    mqttClient.subscribe(TOPIC_CONTROL, 1);
  } else {
    Serial.printf("[MQTT] Echec, rc=%d\n", mqttClient.state());
  }
}


//    CONNEXION WIFI


void connectWifi() {
  Serial.println("[WIFI] Connexion...");

  WiFi.mode(WIFI_STA);
  WiFi.setAutoReconnect(true);
  WiFi.begin(ssid, pass);

  int tries = 0;
  while (WiFi.status() != WL_CONNECTED && tries < 40) {
    delay(500);
    Serial.print(".");
    tries++;
  }

  if (WiFi.status() == WL_CONNECTED) {
    Serial.println();
    Serial.println("[WIFI] Connecté: " + WiFi.localIP().toString());
    Serial.println("[WIFI] MAC: " + WiFi.macAddress());
  } else {
    Serial.println();
    Serial.println("[WIFI] Echec connexion!");
  }
}


//   TÂCHE 1: SensorTask - Priorité 2

void sensorTask(void *parameter) {
  TickType_t lastWakeTime = xTaskGetTickCount();

  Serial.println("[SensorTask] Démarré");

  for (;;) {
    systemState.sensorTaskCounter++;
    Serial.println("\n[SensorTask] === Début cycle acquisition ===");

    float t_local = NAN;
    float h_local = NAN;

    // Lecture capteur local SHT31 avec protection mutex I2C
    if (xSemaphoreTake(i2cMutex, pdMS_TO_TICKS(1000)) == pdTRUE) {
      t_local = sht31.readTemperature();
      h_local = sht31.readHumidity();
      xSemaphoreGive(i2cMutex);
    }

    // Vérification lecture réussie
    if (!isnan(t_local) && !isnan(h_local)) {
      Serial.printf("[SensorTask] Local: T=%.1f°C H=%.1f%%\n", t_local, h_local);

      // Mise à jour avec protection mutex
      if (xSemaphoreTake(dataMutex, pdMS_TO_TICKS(100)) == pdTRUE) {
        systemState.localTemp = t_local;
        systemState.localHumidity = h_local;

        // Calcul des moyennes
        if (systemState.remoteDataValid &&
            (millis() - systemState.remoteDataTimestamp < DATA_VALID_TIMEOUT)) {
          // Données distantes valides -> moyenne
          systemState.avgTemp = (t_local + systemState.remoteTemp) / 2.0;
          systemState.avgHumidity = (h_local + systemState.remoteHumidity) / 2.0;
          Serial.printf("[SensorTask] Moyenne (2 capteurs): T=%.1f°C H=%.1f%%\n",
                        systemState.avgTemp, systemState.avgHumidity);
        } else {
          // Pas de données distantes valides -> utiliser local uniquement
          systemState.avgTemp = t_local;
          systemState.avgHumidity = h_local;
          Serial.println("[SensorTask] Données distantes expirées, utilisation local seul");
        }

        xSemaphoreGive(dataMutex);

        // Publier dans BroadcastQueue
        AveragedData avgData;
        avgData.temperature = systemState.avgTemp;
        avgData.humidity = systemState.avgHumidity;
        avgData.timestamp = millis();
        avgData.isValid = true;

        xQueueOverwrite(BroadcastQueue, &avgData);
        Serial.println("[SensorTask] Données publiées dans BroadcastQueue");
      }
    } else {
      // Erreur de lecture
      Serial.println("[SensorTask] ERREUR lecture capteur local!");

      // Tentative reset capteur
      if (xSemaphoreTake(i2cMutex, pdMS_TO_TICKS(1000)) == pdTRUE) {
        sht31.reset();
        xSemaphoreGive(i2cMutex);
      }
    }

    Serial.println("[SensorTask] === Fin cycle ===\n");

    // Attente 10 secondes
    vTaskDelayUntil(&lastWakeTime, pdMS_TO_TICKS(SENSOR_READ_INTERVAL));
  }
}


//   TÂCHE 2: ControlTask - Priorité 3


void controlTask(void *parameter) {
  TickType_t lastWakeTime = xTaskGetTickCount();
  AveragedData currentData;

  Serial.println("[ControlTask] Démarré");

  for (;;) {
    systemState.controlTaskCounter++;

    // Lire données depuis BroadcastQueue
    if (xQueuePeek(BroadcastQueue, &currentData, 0) == pdTRUE) {

      // Vérifier validité des données (timestamp < 5 min)
      if (currentData.isValid && (millis() - currentData.timestamp < DATA_VALID_TIMEOUT)) {

        Serial.println("\n[ControlTask] === Analyse des données ===");
        Serial.printf("[ControlTask] T=%.1f°C H=%.1f%%\n", currentData.temperature, currentData.humidity);

        // Mode automatique activé ?
        if (systemState.autoModeActive) {
          Serial.println("[ControlTask] Mode AUTO actif");

          

          // Contrôle humidité (prioritaire)
          controleHumidite(currentData.humidity);

          // Contrôle température
          controleTemperature(currentData.temperature);

          // Notifications
          checkAndNotify();
        } else {
          Serial.println("[ControlTask] Mode AUTO inactif");
        }

        Serial.println("[ControlTask] === Fin analyse ===\n");

      } else {
        Serial.println("[ControlTask] Données périmées ou invalides");
      }
    }

    // Attente 10 secondes
    vTaskDelayUntil(&lastWakeTime, pdMS_TO_TICKS(CONTROL_CHECK_INTERVAL));
  }
}


//   TÂCHE 3: SupervisionTask - Priorité 1


void supervisionTask(void *parameter) {
  TickType_t lastWakeTime = xTaskGetTickCount();

  Serial.println("[SupervisionTask] Démarré");

  for (;;) {
    systemState.supervisionTaskCounter++;
    unsigned long now = millis();

    // Vérification connexion WiFi
    if (WiFi.status() != WL_CONNECTED) {
      Serial.println("[SupervisionTask] WiFi déconnecté, reconnexion...");
      WiFi.reconnect();
    }

    // Vérification connexion MQTT
    if (!mqttClient.connected()) {
      connectMQTT();
    }
    mqttClient.loop();

    // Maintien connexion Blynk
    //Blynk.run();
    if (!Blynk.connected()) {
  Blynk.connect(1000);
} else {
  Blynk.run();
}

    // Mise à jour Blynk (toutes les 2 secondes)
    if (now - systemState.lastBlynkUpdate >= BLYNK_UPDATE_INTERVAL) {
      updateBlynkWidgets();
      updateLCDDisplay();
      systemState.lastBlynkUpdate = now;
    }

    // Publication MQTT (toutes les 10 secondes)
    if (now - systemState.lastMqttPublish >= MQTT_PUBLISH_INTERVAL) {
      if (mqttClient.connected()) {
        publishSensorData();
      }
      systemState.lastMqttPublish = now;
    }

    // Attente courte pour réactivité réseau
    vTaskDelayUntil(&lastWakeTime, pdMS_TO_TICKS(1000));
  }
}


//   TÂCHE 4: WatchdogTask - Priorité 0


void watchdogTask(void *parameter) {
  TickType_t lastWakeTime = xTaskGetTickCount();

  Serial.println("[WatchdogTask] Démarré");

  // Initialiser les compteurs
  systemState.lastSensorCount = 0;
  systemState.lastControlCount = 0;
  systemState.lastSupervisionCount = 0;

  for (;;) {
    Serial.println("\n[WatchdogTask] === Vérification système ===");

    bool systemOK = true;

    // Vérification SensorTask
    if (systemState.sensorTaskCounter == systemState.lastSensorCount) {
      Serial.println("[WatchdogTask] ALERTE: SensorTask bloquée!");
      systemOK = false;
    }
    systemState.lastSensorCount = systemState.sensorTaskCounter;

    // Vérification ControlTask
    if (systemState.controlTaskCounter == systemState.lastControlCount) {
      Serial.println("[WatchdogTask] ALERTE: ControlTask bloquée!");
      systemOK = false;
    }
    systemState.lastControlCount = systemState.controlTaskCounter;

    // Vérification SupervisionTask
    if (systemState.supervisionTaskCounter == systemState.lastSupervisionCount) {
      Serial.println("[WatchdogTask] ALERTE: SupervisionTask bloquée!");
      systemOK = false;
    }
    systemState.lastSupervisionCount = systemState.supervisionTaskCounter;

    // Vérification mémoire
    uint32_t freeHeap = ESP.getFreeHeap();
    Serial.printf("[WatchdogTask] Mémoire libre: %d bytes\n", freeHeap);

    if (freeHeap < 10000) {
      Serial.println("[WatchdogTask] ALERTE: Mémoire faible!");
      systemOK = false;
    }

    // Actions en cas de problème
    if (!systemOK) {
      systemState.watchdogResets++;
      Serial.printf("[WatchdogTask] Problèmes détectés! Resets: %d\n", systemState.watchdogResets);

      // Si trop de resets -> redémarrage
      if (systemState.watchdogResets >= 3) {
        Serial.println("[WatchdogTask] REDÉMARRAGE SYSTÈME!");
        delay(1000);
        ESP.restart();
      }
    } else {
      Serial.println("[WatchdogTask] Système OK");
      systemState.watchdogResets = 0; // Reset compteur si tout va bien
    }

    // Afficher statistiques
    Serial.printf("[WatchdogTask] Compteurs - Sensor:%d Control:%d Supervision:%d\n",
                  systemState.sensorTaskCounter,
                  systemState.controlTaskCounter,
                  systemState.supervisionTaskCounter);

    Serial.println("[WatchdogTask] === Fin vérification ===\n");

    // Attente 30 secondes
    vTaskDelayUntil(&lastWakeTime, pdMS_TO_TICKS(WATCHDOG_CHECK_INTERVAL));
  }
}


//   TÂCHE 5: IRTask - Priorité 3


void irTask(void *parameter) {
  IRCommand cmd;

  Serial.println("[IRTask] Démarré");

  for (;;) {
    // Attendre commande dans la queue
    if (xQueueReceive(irCommandQueue, &cmd, portMAX_DELAY) == pdTRUE) {

      // Respecter le cooldown IR
      unsigned long now = millis();
      if (now - systemState.lastIRCommand < IR_COOLDOWN) {
        vTaskDelay(pdMS_TO_TICKS(IR_COOLDOWN - (now - systemState.lastIRCommand)));
      }

      Serial.printf("[IRTask] Envoi commande: type=%d value=%d\n", cmd.type, cmd.value);

      switch(cmd.type) {
        case 0: // Power
          if (cmd.value) {
            irsend.sendRaw(powerON, 211, 38);
          } else {
            irsend.sendRaw(powerOFF, 211, 38);
          }
          break;

        case 1: // Mode
          switch(cmd.value) {
            case 0: irsend.sendRaw(modeAuto, 211, 38); break;
            case 1: irsend.sendRaw(modeCool, 211, 38); break;
            case 2: irsend.sendRaw(modeDry, 211, 38); break;
            case 3: irsend.sendRaw(modeHeat, 211, 38); break;
            case 4: irsend.sendRaw(modeFan, 211, 38); break;
          }
          break;

        case 2: // Température
          sendTempIR(cmd.value);
          break;

        case 3: // Vitesse ventilateur
          switch(cmd.value) {
            
            case 1: irsend.sendRaw(speedLow, 211, 38); break;
            case 2: irsend.sendRaw(speedMedium, 211, 38); break;
            case 3: irsend.sendRaw(speedHigh, 211, 38); break;
          }
          break;

        case 4: // Lumière
          irsend.sendRaw(light, 211, 38);
          break;
      }

      systemState.lastIRCommand = millis();
    }
  }
}


//    HANDLERS BLYNK


// V0: Power ON/OFF
BLYNK_WRITE(V0) {
  int value = param.asInt();
  sendIRCommand(0, value);
  systemState.acPowerState = value;
  updateLCDDisplay();
  Serial.printf("[Blynk] Power: %s\n", value ? "ON" : "OFF");
}

// V1: Light
BLYNK_WRITE(V1) {
  if (param.asInt() == 1) {
    sendIRCommand(4, 0);
    Blynk.virtualWrite(V1, 0);
    Serial.println("[Blynk] Light toggle");
  }
}

// V2: Temp +
BLYNK_WRITE(V2) {
  if (param.asInt() && systemState.currentTemp < 30) {
    systemState.currentTemp++;
    sendIRCommand(2, systemState.currentTemp);
    updateLCDDisplay();
    Serial.printf("[Blynk] Temp+: %d°C\n", systemState.currentTemp);
  }
  Blynk.virtualWrite(V2, 0);
}

// V3: Temp -
BLYNK_WRITE(V3) {
  if (param.asInt() && systemState.currentTemp > 16) {
    systemState.currentTemp--;
    sendIRCommand(2, systemState.currentTemp);
    updateLCDDisplay();
    Serial.printf("[Blynk] Temp-: %d°C\n", systemState.currentTemp);
  }
  Blynk.virtualWrite(V3, 0);
}

// V4: Mode
BLYNK_WRITE(V4) {
  if (param.asInt()) {
    systemState.currentMode++;
    if (systemState.currentMode > 4) systemState.currentMode = 0;
    sendIRCommand(1, systemState.currentMode);
    updateLCDDisplay();

    const char* modes[] = {"Auto", "Cool", "Dry", "Heat", "Fan"};
    Serial.printf("[Blynk] Mode: %s\n", modes[systemState.currentMode]);
  }
  Blynk.virtualWrite(V4, 0);
}

// V5: Fan Speed
BLYNK_WRITE(V5) {
  if (param.asInt()) {
    systemState.currentSpeed++;
    if (systemState.currentSpeed > 3) systemState.currentSpeed = 0;
    sendIRCommand(3, systemState.currentSpeed);
    updateLCDDisplay();

    const char* speeds[] = {"Auto", "Low", "Medium", "High"};
    Serial.printf("[Blynk] Fan: %s\n", speeds[systemState.currentSpeed]);
  }
  Blynk.virtualWrite(V5, 0);
}

// V11: Auto Mode
BLYNK_WRITE(V11) {
  systemState.autoModeActive = param.asInt();
  updateLCDDisplay();
  Serial.printf("[Blynk] Auto Mode: %s\n", systemState.autoModeActive ? "ON" : "OFF");
}



void setup() {
  Serial.begin(115200);
  delay(1000);

  Serial.println("\n");
  Serial.println("  ================================  ");
  Serial.println("  SYSTÈME DE CONTRÔLE ENVIRONNEMENTAL  ");
  Serial.println("  Module Récepteur - FreeRTOS  ");
  Serial.println("  Version 3.0  ");
  Serial.println("  ================================  ");
  Serial.println();

  // ===== 1. Initialisation I2C et capteur SHT31 =====
  Serial.println("[INIT] Initialisation I2C et SHT31...");
  Wire.begin(I2C_SDA, I2C_SCL);

  if (!sht31.begin(0x44)) {
    Serial.println("[INIT] ERREUR: SHT31 non détecté!");
  } else {
    Serial.println("[INIT] SHT31 OK");
  }

  // ===== 2. Initialisation IR =====
  Serial.println("[INIT] Initialisation émetteur IR...");
  irsend.begin();
  //irsend_backup.begin(); // ← NOUVEAU
  //Serial.println("[INIT] IR OK");

  // ===== 3. Connexion WiFi =====
  connectWifi();

  // ===== 4. Initialisation ESP-NOW =====
  Serial.println("[INIT] Initialisation ESP-NOW...");
  if (esp_now_init() == ESP_OK) {
    esp_now_register_recv_cb(onDataRecv);
    Serial.println("[INIT] ESP-NOW OK");
  } else {
    Serial.println("[INIT] ERREUR ESP-NOW!");
  }

  // ===== 5. Configuration Blynk =====
  Serial.println("[INIT] Configuration Blynk...");
  Blynk.config(BLYNK_AUTH_TOKEN, "blynk.cloud", 80);
  Blynk.connect(3000);
  Serial.println("[INIT] Blynk OK");

  // ===== 6. Configuration MQTT =====
  Serial.println("[INIT] Configuration MQTT...");
  mqttClient.setServer(MQTT_BROKER, MQTT_PORT);
  mqttClient.setCallback(mqttCallback);
  mqttClient.setBufferSize(512);
  mqttClient.setKeepAlive(60);
  connectMQTT();

  // ===== 7. Création objets FreeRTOS =====
  Serial.println("[INIT] Création objets FreeRTOS...");

  // Queues
  BroadcastQueue = xQueueCreate(1, sizeof(AveragedData));
  irCommandQueue = xQueueCreate(10, sizeof(IRCommand));

  // Mutex
  dataMutex = xSemaphoreCreateMutex();
  i2cMutex = xSemaphoreCreateMutex();

  if (BroadcastQueue == NULL || irCommandQueue == NULL ||
      dataMutex == NULL || i2cMutex == NULL) {
    Serial.println("[INIT] ERREUR création objets FreeRTOS!");
  } else {
    Serial.println("[INIT] Objets FreeRTOS OK");
  }

  // ===== 8. Création des tâches FreeRTOS =====
  Serial.println("[INIT] Création des tâches FreeRTOS...");
  
 systemState.autoModeActive = true;

  // controlTask - Priorité 3 (haute)
  xTaskCreatePinnedToCore(
    controlTask,
    "ControlTask",
    4096,
    NULL,
    3,
    &controlTaskHandle,
    0
  );

  // SensorTask - Priorité 2
  xTaskCreatePinnedToCore(
    sensorTask,
    "SensorTask",
    4096,
    NULL,
    2,
    &sensorTaskHandle,
    0
  );

  // SupervisionTask - Priorité 1
  xTaskCreatePinnedToCore(
    supervisionTask,
    "SupervisionTask",
    8192,
    NULL,
    1,
    &supervisionTaskHandle,
    1
  );

// IRTask - Priorité 3
xTaskCreatePinnedToCore(
  irTask,
  "IRTask",
  4096,
  NULL,
  3,
  &irTaskHandle,
  1
);

xTaskCreatePinnedToCore(
  watchdogTask,
  "WatchdogTask",
  4096,
  NULL,
  0,
  &watchdogTaskHandle,
  0
);

























  // ===== Fin initialisation =====
  Serial.println();
  Serial.println("  ================================  ");
  Serial.println("         SYSTÈME OPÉRATIONNEL       ");
  Serial.println("  ================================  ");
  Serial.println();

  // Mise à jour initiale affichage
  updateLCDDisplay();
}


//   LOOP (Vide - FreeRTOS gère tout)

void loop() {
  // Dans FreeRTOS, loop() n'est pas utilisé
}
